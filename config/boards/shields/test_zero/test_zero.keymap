/*
 * Copyright (c) 2022 Gleb Sabirzyanov
 *
 * SPDX-License-Identifier: MIT
 */

#include <behaviors.dtsi>
#include <dt-bindings/zmk/keys.h>
#include <dt-bindings/zmk/rgb.h>

/ {
    keymap {
        compatible = "zmk,keymap";
        
        default_layer {
            bindings = <  
                &kp N1     &kp N2     &kp N3     &rgb_ug RGB_TOG   &kp N5     &kp N6     
            >;
        };
    };
};



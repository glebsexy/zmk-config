/*
 * Copyright (c) 2021 The ZMK Contributors
 *
 * SPDX-License-Identifier: MIT
 */

#include <dt-bindings/zmk/matrix_transform.h>

// west build -d build/deathpad -p auto -b seeeduino_xiao_ble -- -DZMK_CONFIG="/Users/glebsabirzyanov/Projects/Keyboards/firmware/zmk-config/config" -DSHIELD=deathpad

/ {
  chosen {
    zmk,kscan = &kscan0;
    // zmk,matrix_transform = &default_transform;
  };

  kscan0: kscan {
    compatible = "zmk,kscan-gpio-matrix";
    label = "KSCAN";

    diode-direction = "col2row";

    col-gpios
      = <&gpio0 10 GPIO_ACTIVE_HIGH>
      , <&gpio0 9 GPIO_ACTIVE_HIGH>
      , <&gpio0 3 GPIO_ACTIVE_HIGH>
      ;

    row-gpios
      = <&gpio0 0 (GPIO_ACTIVE_HIGH | GPIO_PULL_DOWN)>
      , <&gpio0 1 (GPIO_ACTIVE_HIGH | GPIO_PULL_DOWN)>
      , <&gpio0 2 (GPIO_ACTIVE_HIGH | GPIO_PULL_DOWN)>
      ;
  };


  // default_transform: keymap_transform_0 {
  //     compatible = "zmk,matrix-transform";
  //     rows = <8>;
  //     columns = <5>;
  //     // ($row * NUMBER_OF_COLUMNS) + $column
  //     // RC(row, column)
  //     map = <
  //       RC(0,4) RC(0,0) RC(0,1) RC(0,2) RC(0,3)     RC(7,3) RC(7,2) RC(7,1) RC(7,0) RC(7,4) 
  //       RC(1,4) RC(1,0) RC(1,1) RC(1,2) RC(1,3)     RC(6,3) RC(6,2) RC(6,1) RC(6,0) RC(6,4) 
  //       RC(2,4) RC(2,0) RC(2,1) RC(2,2) RC(2,3)     RC(5,3) RC(5,2) RC(5,1) RC(5,0) RC(5,4) 
  //       RC(3,4) RC(3,0) RC(3,2) RC(3,1)     RC(3,3) RC(4,3)     RC(4,1) RC(4,2) RC(4,0) RC(4,4) 
  //     >;
  // };


};
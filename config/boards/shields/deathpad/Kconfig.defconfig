## config/boards/shields/deathpad/Kconfig.defconfig
```kconfig
# Copyright (c) 2022 The ZMK Contributors
# SPDX-License-Identifier: MIT

if SHIELD_DEATHPAD

config ZMK_KEYBOARD_NAME
	default "Deathpad"

# config ZMK_USB
# 	default y

endif
```

## config/boards/shields/savis_warbler/Kconfig.defconfig
```kconfig
# Copyright (c) 2022 Gleb Sabirzyanov
# SPDX-License-Identifier: MIT

if SHIELD_SAVIS_WARBLER

config ZMK_KEYBOARD_NAME
	default "Savi Warbler"

endif
```

## config/boards/shields/savis_warbler/Kconfig.shield
```kconfig
# Copyright (c) 2022 Gleb Sabirzyanov
# SPDX-License-Identifier: MIT

config SHIELD_SAVIS_WARBLER
	def_bool $(shields_list_contains,savis_warbler)

config SYSTEM_WORKQUEUE_STACK_SIZE
	int "work queue stack size"
  default 4096

config CONFIG_MAIN_STACK_SIZE
	int "main stack size"
  default 2048
```

## config/boards/shields/sexy_acrylic/Kconfig.defconfig
```kconfig
# Copyright (c) 2022 Gleb Sabirzyanov
# SPDX-License-Identifier: MIT

if SHIELD_SEXY_ACRYLIC

config ZMK_KEYBOARD_NAME
	default "Sexy Acrylic Keyboard"

endif
```

## config/boards/shields/sexy_acrylic/Kconfig.shield
```kconfig
# Copyright (c) 2022 Gleb Sabirzyanov
# SPDX-License-Identifier: MIT

config SHIELD_SEXY_ACRYLIC
	def_bool $(shields_list_contains,sexy_acrylic)

config SYSTEM_WORKQUEUE_STACK_SIZE
	int "work queue stack size"
  default 4096

config CONFIG_MAIN_STACK_SIZE
	int "main stack size"
  default 2048
```

## config/boards/shields/sexy_artsey/Kconfig.defconfig
```kconfig
# Copyright (c) 2022 The ZMK Contributors
# SPDX-License-Identifier: MIT

if SHIELD_SEXY_ARTSEY

config ZMK_KEYBOARD_NAME
	default "Sexy Artsey"

config ZMK_USB
	default y

endif
```

## config/boards/shields/sexy_artsey/Kconfig.shield
```kconfig
# Copyright (c) 2022 The ZMK Contributors
# SPDX-License-Identifier: MIT

config SHIELD_SEXY_ACRYLIC
	def_bool $(shields_list_contains,sexy_artsey)
```

## config/boards/shields/sexy_artsey_3d/Kconfig.shield
```kconfig
# Copyright (c) 2022 The ZMK Contributors
# SPDX-License-Identifier: MIT

config SHIELD_SEXY_ARTSEY_3D
	def_bool $(shields_list_contains,sexy_artsey_3d)
```

## config/boards/shields/tern_ble/Kconfig.defconfig
```kconfig
# Copyright (c) 2022 The ZMK Contributors
# SPDX-License-Identifier: MIT

if SHIELD_TERN_BLE

config ZMK_KEYBOARD_NAME
    default "Tern"

endif
```

## config/boards/shields/tern_ble/Kconfig.shield
```kconfig
# Copyright (c) 2022 The ZMK Contributors
# SPDX-License-Identifier: MIT

config SHIELD_TERN_BLE
   def_bool $(shields_list_contains,tern_ble)
```

## config/boards/shields/test_zero/Kconfig.defconfig
```kconfig
# Copyright (c) 2022 Gleb Sabirzyanov
# SPDX-License-Identifier: MIT

if SHIELD_TEST_ZERO

config ZMK_KEYBOARD_NAME
	default "Test Zero"

endif
```

## config/boards/shields/test_zero/Kconfig.shield
```kconfig
# Copyright (c) 2022 Gleb Sabirzyanov
# SPDX-License-Identifier: MIT

config SHIELD_TEST_ZERO
	def_bool $(shields_list_contains,test_zero)
```

## config/west.yml
```yaml
manifest:
  remotes:
    - name: zmkfirmware
      url-base: https://github.com/zmkfirmware
    - name: glebsexy
      url-base: https://github.com/glebsexy
  projects:
    - name: zmk
      remote: glebsexy
      revision: main
      import: app/west.yml
  self:
    path: config
```
